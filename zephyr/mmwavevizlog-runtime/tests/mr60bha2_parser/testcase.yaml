## zephyr/mmwavevizlog-runtime/tests/mr60bha2_parser/testcase.yaml
```yaml
tests:
  drivers.mr60bha2.parser:
    tags:
      - drivers
      - mr60bha2
      - parser
    platform_allow:
      - native_sim
    harness: ztest
```
